## boardsupport/bsp/configs/wifilmr_defconfig
```kconfig
BR2_arm=y
BR2_arm1176jzf_s=y
BR2_CCACHE=y
BR2_CCACHE_DIR="$(HOME)/.ccache"
BR2_TOOLCHAIN_BUILDROOT_GLIBC=y
BR2_PACKAGE_HOST_LINUX_HEADERS_CUSTOM_4_14=y
BR2_GCC_VERSION_8_X=y
BR2_TOOLCHAIN_BUILDROOT_CXX=y
BR2_ROOTFS_OVERLAY="$(BR2_EXTERNAL)/rootfs_overlay"
BR2_ROOTFS_POST_BUILD_SCRIPT="board/raspberrypi0w/post-build.sh"
BR2_ROOTFS_POST_IMAGE_SCRIPT="board/raspberrypi0w/post-image.sh"
BR2_ROOTFS_POST_SCRIPT_ARGS="--add-pi3-miniuart-bt-overlay"
BR2_LINUX_KERNEL=y
BR2_LINUX_KERNEL_CUSTOM_TARBALL=y
BR2_LINUX_KERNEL_CUSTOM_TARBALL_LOCATION="$(call github,raspberrypi,linux,865ddc1393f558198e7e7ce70928ff2e49c4f7f6)/linux-865ddc1393f558198e7e7ce70928ff2e49c4f7f6.tar.gz"
BR2_LINUX_KERNEL_USE_CUSTOM_CONFIG=y
BR2_LINUX_KERNEL_CUSTOM_CONFIG_FILE="$(BR2_EXTERNAL)/linux_defconfig"
BR2_LINUX_KERNEL_DTS_SUPPORT=y
BR2_LINUX_KERNEL_INTREE_DTS_NAME="bcm2708-rpi-0-w"
BR2_PACKAGE_LINUX_TOOLS_GPIO=y
BR2_PACKAGE_LINUX_TOOLS_IIO=y
BR2_PACKAGE_FBV=y
# BR2_PACKAGE_FBV_PNG is not set
# BR2_PACKAGE_FBV_JPEG is not set
# BR2_PACKAGE_FBV_GIF is not set
BR2_PACKAGE_TK=y
BR2_PACKAGE_XORG7=y
BR2_PACKAGE_XSERVER_XORG_SERVER=y
BR2_PACKAGE_XAPP_XCLOCK=y
BR2_PACKAGE_XAPP_XINIT=y
BR2_PACKAGE_XDRIVER_XF86_INPUT_KEYBOARD=y
BR2_PACKAGE_XDRIVER_XF86_VIDEO_FBDEV=y
BR2_PACKAGE_XDRIVER_XF86_VIDEO_FBTURBO=y
BR2_PACKAGE_RPI_BT_FIRMWARE=y
BR2_PACKAGE_RPI_FIRMWARE=y
BR2_PACKAGE_RPI_FIRMWARE_CUSTOM_CONFIG_TXT="$(BR2_EXTERNAL)/configs/config.txt"
BR2_PACKAGE_RPI_WIFI_FIRMWARE=y
BR2_PACKAGE_PYTHON3=y
BR2_PACKAGE_PYTHON3_ZLIB=y
BR2_PACKAGE_PYTHON3_TKINTER=y
BR2_PACKAGE_ALSA_LIB=y
BR2_TARGET_ROOTFS_EXT2=y
BR2_TARGET_ROOTFS_EXT2_4=y
BR2_TARGET_ROOTFS_EXT2_SIZE="200M"
# BR2_TARGET_ROOTFS_TAR is not set
BR2_PACKAGE_HOST_DOSFSTOOLS=y
BR2_PACKAGE_HOST_GENIMAGE=y
BR2_PACKAGE_HOST_MTOOLS=y
BR2_PACKAGE_RADIOAPP=y
```

## boardsupport/bsp/package/Config.in
```kconfig
source "$BR2_EXTERNAL_WiFiLMR_PATH/package/wifilmr/radioapp/Config.in"
source "$BR2_EXTERNAL_WiFiLMR_PATH/package/wifilmr/python3-opuslib/Config.in"
source "$BR2_EXTERNAL_WiFiLMR_PATH/package/wifilmr/python3-pymumble/Config.in"
```

## boardsupport/bsp/package/wifilmr/python3-opuslib/Config.in
```kconfig
config BR2_PACKAGE_PYTHON3_OPUSLIB
	bool "python3-opuslib"
	select BR2_PACKAGE_OPUS
	help
	  Python bindings to the libopus, IETF low-delay audio codec

	  https://github.com/onbeep/opuslib
```

## boardsupport/bsp/package/wifilmr/python3-pymumble/Config.in
```kconfig
config BR2_PACKAGE_PYTHON3_PYMUMBLE
	bool "python3-pymumble"
	help
	  PYMUMBLE python library

	  https://github.com/azlux/pymumble/
```

## boardsupport/bsp/package/wifilmr/radioapp/Config.in
```kconfig
config BR2_PACKAGE_RADIOAPP
	bool "radioapp"
	select BR2_PACKAGE_PYTHON_TKINTER
	select BR2_PACKAGE_XAPP_XSET
	help
	  WifiLMR radioapp.

	  https://github.com/EECS581Team15/WifiLMR/
```
